// Pinned root CAs for the HTTPS prototype (DESIGN.md SS2.1), and which root each data source
// must chain to. Only meaningful with -DTRANSIT_HTTPS; tls_roots.cpp (generated by
// tools/gen_tls_roots.py) is empty without it.
//
// Why a few pinned roots and not a CA bundle: the SDK's full bundle is ~70 KB of flash the app
// slot does not have (firmware/README.md), and mbedTLS parses whatever it is given into RAM at
// every handshake - one root is ~2 KB of heap for the handshake's duration, a bundle of 200 is
// not an option on a board with ~75 KB free. Three roots are 3.9 KB of flash as PEM, and one is
// handed to NetworkClientSecure::setCACert() per host, so SEPTA's certificate must chain to
// Amazon and nothing else will do - the tightest pin the sources allow.
//
// Rotation risk, stated plainly: the roots themselves are good until 2035-2038, but a data source
// can switch CA at any time (SEPTA moving off AWS's CA, Open-Meteo leaving Let's Encrypt, Bicycle
// Transit leaving Cloudflare). When that happens the handshake fails closed with a certificate
// error - never a silent downgrade (http_fetch.cpp) - and /api/state's "transport" block shows
// cert_failed climbing. The fix is a firmware update: `tools/gen_tls_roots.py <new root>.pem`, add
// the host below, rebuild. With `device.transport = "https_preferred"` the display keeps working
// over plain HTTP only while the heap gate says TLS is unaffordable, NOT because of the bad
// certificate; with "https" the stop reads unavailable until the update lands.
#pragma once
#ifdef TRANSIT_HTTPS
#include <cstring>
#include <strings.h>

namespace transit_app {
namespace tls_roots {
extern const char kAmazonRootCa1[];  // www3.septa.org (Amazon RSA 2048 M01 -> Amazon Root CA 1)
extern const char kIsrgRootX1[];     // api.open-meteo.com (Let's Encrypt YR2 -> Root YR, cross-signed by ISRG Root X1)
extern const char kGtsRootR4[];      // bts-status.bicycletransit.workers.dev (Cloudflare, GTS WE1 -> GTS Root R4)
}  // namespace tls_roots

// The one root `host` (or any subdomain of it) must chain to, or nullptr for a host nobody has
// pinned - which http_fetch.cpp treats as a certificate failure, not as permission to skip
// verification. Verified 2026-09-16 with `openssl verify` against each single root and the
// served chain, default store disabled (DESIGN.md SS2.1).
inline const char *pinnedRootsForHost(const char *host) {
  struct Pin {
    const char *suffix;
    const char *pem;
  };
  static const Pin kPins[] = {
#ifdef TRANSIT_HTTPS_BADPIN_TEST
      // Test hook for the fail-closed proof (DESIGN.md SS2.1 device test 5), never in a shipped
      // image: SEPTA pinned to the wrong root, so every SEPTA handshake must end in -0x2700 and
      // the stop must read unavailable with no plain-http fetch leaving the device. Build with
      //   PLATFORMIO_BUILD_FLAGS=-DTRANSIT_HTTPS_BADPIN_TEST pio run -e <env>
      {"septa.org", tls_roots::kIsrgRootX1},
#else
      {"septa.org", tls_roots::kAmazonRootCa1},
#endif
      {"open-meteo.com", tls_roots::kIsrgRootX1},
      {"bicycletransit.workers.dev", tls_roots::kGtsRootR4},
  };
  if (host == nullptr) return nullptr;
  const size_t hl = strlen(host);
  for (const Pin &p : kPins) {
    const size_t sl = strlen(p.suffix);
    if (hl < sl) continue;
    if (strcasecmp(host + hl - sl, p.suffix) != 0) continue;
    if (hl == sl || host[hl - sl - 1] == '.') return p.pem;  // exact host or a subdomain, never "notsepta.org"
  }
  return nullptr;
}

}  // namespace transit_app
#endif  // TRANSIT_HTTPS
